## configs/arc_vdk_hs_defconfig
```kconfig
BR2_arcle=y
BR2_archs=y
BR2_TOOLCHAIN_EXTERNAL=y
BR2_TOOLCHAIN_EXTERNAL_PATH="/home/akolesov/gnu/base/INSTALL-hs"
BR2_TOOLCHAIN_EXTERNAL_CUSTOM_PREFIX="$(ARCH)-linux-uclibc"
BR2_TOOLCHAIN_EXTERNAL_HEADERS_3_13=y
BR2_TOOLCHAIN_EXTERNAL_LARGEFILE=y
BR2_TOOLCHAIN_EXTERNAL_LOCALE=y
# BR2_TOOLCHAIN_EXTERNAL_HAS_THREADS_NPTL is not set
BR2_TOOLCHAIN_EXTERNAL_INET_RPC=y
BR2_TOOLCHAIN_EXTERNAL_CXX=y
BR2_TARGET_OPTIMIZATION="-pipe -Os"
BR2_LINUX_KERNEL=y
BR2_LINUX_KERNEL_CUSTOM_LOCAL=y
BR2_LINUX_KERNEL_CUSTOM_LOCAL_PATH="/home/akolesov/vdk/linux"
BR2_LINUX_KERNEL_DEFCONFIG="vdk_hs"
BR2_LINUX_KERNEL_VMLINUX=y
BR2_PACKAGE_BUSYBOX_CONFIG="package/busybox/busybox-arc-fae-training.config"
BR2_PACKAGE_GDB=y
BR2_TARGET_ROOTFS_CPIO=y
# BR2_TARGET_ROOTFS_TAR is not set
BR2_PACKAGE_HOST_E2FSPROGS=y
BR2_PACKAGE_HOST_GENEXT2FS=y
```

## configs/archs-ex-rootfs_defconfig
```kconfig
BR2_arcle=y
BR2_archs38=y
# BR2_ARC_ATOMIC_EXT is not set
BR2_TOOLCHAIN_BUILDROOT_LARGEFILE=y
BR2_TOOLCHAIN_BUILDROOT_INET_IPV6=y
BR2_TOOLCHAIN_BUILDROOT_INET_RPC=y
# BR2_TARGET_GENERIC_GETTY is not set
BR2_PACKAGE_LMBENCH=y
BR2_PACKAGE_LTP_TESTSUITE=y
BR2_PACKAGE_RT_TESTS=y
BR2_TARGET_ROOTFS_CPIO=y
```

## configs/axs101_fpu_defconfig
```kconfig
BR2_arcle=y
BR2_ARC_ATOMIC_EXT=y
BR2_TOOLCHAIN_BUILDROOT_LARGEFILE=y
BR2_TOOLCHAIN_BUILDROOT_INET_RPC=y
BR2_TARGET_OPTIMIZATION="-pipe -mspfp -mdpfp"
BR2_TARGET_GENERIC_GETTY_PORT="ttyS3"
BR2_LINUX_KERNEL=y
BR2_LINUX_KERNEL_CUSTOM_TARBALL=y
BR2_LINUX_KERNEL_CUSTOM_TARBALL_LOCATION="linux-v2-hs_700_benchmarking.tar.gz"
BR2_LINUX_KERNEL_DEFCONFIG="axs101_fpga"
BR2_LINUX_KERNEL_VMLINUX=y
BR2_PACKAGE_LMBENCH=y
BR2_TARGET_ROOTFS_INITRAMFS=y
```

## configs/axs103_defconfig
```kconfig
BR2_arcle=y
BR2_archs38=y
BR2_TOOLCHAIN_BUILDROOT_LARGEFILE=y
BR2_TOOLCHAIN_BUILDROOT_INET_IPV6=y
BR2_TOOLCHAIN_BUILDROOT_INET_RPC=y
BR2_TOOLCHAIN_BUILDROOT_LOCALE=y
BR2_PTHREAD_DEBUG=y
BR2_TOOLCHAIN_BUILDROOT_CXX=y
BR2_PACKAGE_HOST_GDB=y
# BR2_TARGET_GENERIC_GETTY is not set
BR2_LINUX_KERNEL=y
BR2_LINUX_KERNEL_CUSTOM_TARBALL=y
BR2_LINUX_KERNEL_CUSTOM_TARBALL_LOCATION="linux-v2.tar.gz"
BR2_LINUX_KERNEL_DEFCONFIG="axs103_smp"
BR2_LINUX_KERNEL_VMLINUX=y
BR2_PACKAGE_GDB=y
BR2_PACKAGE_HTOP=y
BR2_TARGET_ROOTFS_INITRAMFS=y
```

## configs/ezchip_defconfig
```kconfig
BR2_arceb=y
BR2_JLEVEL=32
BR2_KERNEL_HEADERS_3_10=y
BR2_TOOLCHAIN_BUILDROOT_LARGEFILE=y
BR2_TOOLCHAIN_BUILDROOT_WCHAR=y
BR2_PTHREAD_DEBUG=y
BR2_PACKAGE_HOST_GDB=y
BR2_LINUX_KERNEL=y
BR2_LINUX_KERNEL_CUSTOM_GIT=y
BR2_LINUX_KERNEL_CUSTOM_GIT_REPO_URL="/home/akolesov/kernel/linux"
BR2_LINUX_KERNEL_CUSTOM_GIT_VERSION="ezchip-3.10-arc-mods"
BR2_LINUX_KERNEL_PATCH="~/buildroot/linux"
BR2_LINUX_KERNEL_DEFCONFIG="nps"
BR2_PACKAGE_GDB=y
BR2_TARGET_ROOTFS_CPIO=y
# BR2_TARGET_ROOTFS_TAR is not set
```

## configs/glibc_testing_defconfig
```kconfig
BR2_arcle=y
BR2_archs38=y
BR2_TOOLCHAIN_BUILDROOT_GLIBC=y
BR2_KERNEL_HEADERS_4_17=y
BR2_TOOLCHAIN_BUILDROOT_CXX=y
BR2_TOOLCHAIN_GLIBC_GCONV_LIBS_COPY=y
BR2_TARGET_GENERIC_HOSTNAME=""
BR2_TARGET_GENERIC_ISSUE=""
BR2_SYSTEM_DHCP="eth0"
BR2_SYSTEM_ENABLE_NLS=y
BR2_ROOTFS_OVERLAY="board/synopsys/hsdk/fs-overlay"
BR2_LINUX_KERNEL=y
BR2_LINUX_KERNEL_CUSTOM_VERSION=y
BR2_LINUX_KERNEL_CUSTOM_VERSION_VALUE="4.18-rc7"
BR2_LINUX_KERNEL_PATCH="board/synopsys/hsdk/patches/linux"
BR2_LINUX_KERNEL_DEFCONFIG="hsdk"
BR2_LINUX_KERNEL_CONFIG_FRAGMENT_FILES="board/synopsys/hsdk/linux.fragment"
BR2_LINUX_KERNEL_DTS_SUPPORT=y
BR2_LINUX_KERNEL_INTREE_DTS_NAME="hsdk"
BR2_PACKAGE_GDB=y
BR2_PACKAGE_GDB_DEBUGGER=y
BR2_PACKAGE_STRACE=y
BR2_PACKAGE_SSHFS=y
BR2_PACKAGE_PYTHON3=y
BR2_PACKAGE_PYTHON_PEXPECT=y
BR2_PACKAGE_NTP=y
BR2_PACKAGE_NTP_NTPDATE=y
BR2_TARGET_ROOTFS_CPIO_GZIP=y
BR2_TARGET_ROOTFS_INITRAMFS=y
```

## configs/hs38_vdk_defconfig
```kconfig
BR2_arcle=y
BR2_archs=y
BR2_TOOLCHAIN_BUILDROOT_LARGEFILE=y
BR2_TOOLCHAIN_BUILDROOT_INET_IPV6=y
BR2_TOOLCHAIN_BUILDROOT_INET_RPC=y
BR2_TOOLCHAIN_BUILDROOT_LOCALE=y
BR2_PTHREADS_OLD=y
BR2_PTHREAD_DEBUG=y
BR2_TOOLCHAIN_BUILDROOT_CXX=y
BR2_PACKAGE_HOST_GDB=y
BR2_TARGET_OPTIMIZATION="-pipe -Os"
BR2_TARGET_GENERIC_HOSTNAME="axs103"
BR2_TARGET_GENERIC_ISSUE="Welcome to the AXS103 Software Development Platform"
BR2_INIT_SYSV=y
BR2_ROOTFS_DEVICE_CREATION_DYNAMIC_MDEV=y
BR2_TARGET_GENERIC_GETTY_PORT="ttyS3"
# BR2_TARGET_GENERIC_REMOUNT_ROOTFS_RW is not set
BR2_LINUX_KERNEL=y
BR2_LINUX_KERNEL_CUSTOM_GIT=y
BR2_LINUX_KERNEL_CUSTOM_REPO_URL="https://github.com/foss-for-synopsys-dwc-arc-processors/linux.git"
BR2_LINUX_KERNEL_CUSTOM_REPO_VERSION="d47f5156f0e92cac961bc9ee0ed654128b3c2e77"
BR2_LINUX_KERNEL_DEFCONFIG="hs38_vdk"
BR2_LINUX_KERNEL_VMLINUX=y
BR2_PACKAGE_FFMPEG=y
BR2_PACKAGE_MPLAYER=y
BR2_PACKAGE_GDB=y
BR2_PACKAGE_GDB_SERVER=y
BR2_PACKAGE_PERF=y
BR2_PACKAGE_DIRECTFB=y
# BR2_PACKAGE_DIRECTFB_LINUXINPUT is not set
BR2_PACKAGE_DIRECTFB_EXAMPLES=y
BR2_PACKAGE_DIRECTFB_EXAMPLES_DOK=y
BR2_PACKAGE_I2C_TOOLS=y
BR2_PACKAGE_USBUTILS=y
BR2_PACKAGE_LZO=y
BR2_PACKAGE_ZLIB=y
BR2_PACKAGE_LIBUSB_COMPAT=y
BR2_PACKAGE_DROPBEAR=y
BR2_PACKAGE_DROPBEAR_SMALL=y
BR2_TARGET_ROOTFS_EXT2=y
BR2_TARGET_ROOTFS_TAR=y
BR2_TARGET_ROOTFS_TAR_GZIP=y
BR2_PACKAGE_HOST_E2FSPROGS=y
BR2_PACKAGE_HOST_GENEXT2FS=y
```

## configs/nsimosci_defconfig
```kconfig
BR2_arcle=y
BR2_ARC_ATOMIC_EXT=y
BR2_LINUX_KERNEL=y
BR2_LINUX_KERNEL_CUSTOM_GIT=y
BR2_LINUX_KERNEL_CUSTOM_REPO_URL="https://github.com/foss-for-synopsys-dwc-arc-processors/linux"
BR2_LINUX_KERNEL_CUSTOM_REPO_VERSION="arc-3.13"
BR2_LINUX_KERNEL_DEFCONFIG="nsimosci"
BR2_LINUX_KERNEL_VMLINUX=y
BR2_TARGET_ROOTFS_INITRAMFS=y
```

## configs/nsimosci_hs_smp_defconfig
```kconfig
BR2_arcle=y
BR2_archs=y
BR2_ARC_ATOMIC_EXT=y
BR2_LINUX_KERNEL=y
BR2_LINUX_KERNEL_CUSTOM_LOCAL=y
BR2_LINUX_KERNEL_CUSTOM_LOCAL_PATH="/home/abrodkin/Projects/arc/sources/github/foss-for-synopsys-dwc-arc-processors/linux"
BR2_LINUX_KERNEL_DEFCONFIG="nsimosci_hs_smp"
BR2_LINUX_KERNEL_VMLINUX=y
BR2_TARGET_ROOTFS_INITRAMFS=y
```

## configs/sdplite-smp2x-nollsc-bench_defconfig
```kconfig
BR2_arcle=y
BR2_archs38=y
# BR2_ARC_ATOMIC_EXT is not set
BR2_TOOLCHAIN_BUILDROOT_LARGEFILE=y
BR2_TOOLCHAIN_BUILDROOT_INET_IPV6=y
BR2_TOOLCHAIN_BUILDROOT_INET_RPC=y
BR2_LINUX_KERNEL=y
BR2_LINUX_KERNEL_CUSTOM_TARBALL=y
BR2_LINUX_KERNEL_CUSTOM_TARBALL_LOCATION="linux-v2-hs_bringup.tar.gz"
BR2_LINUX_KERNEL_DEFCONFIG="sdplite_smp_ex"
BR2_LINUX_KERNEL_VMLINUX=y
BR2_PACKAGE_LMBENCH=y
BR2_PACKAGE_LTP_TESTSUITE=y
BR2_PACKAGE_RT_TESTS=y
BR2_TARGET_ROOTFS_INITRAMFS=y
```

## configs/snps-archs-qt5_defconfig
```kconfig
BR2_arcle=y
BR2_archs38=y
BR2_OPTIMIZE_0=y
BR2_TOOLCHAIN_BUILDROOT_INET_RPC=y
BR2_TOOLCHAIN_BUILDROOT_LOCALE=y
BR2_PTHREAD_DEBUG=y
BR2_TOOLCHAIN_BUILDROOT_CXX=y
BR2_SYSTEM_DHCP="eth0"
BR2_PACKAGE_QT5=y
BR2_PACKAGE_QT5BASE_LICENSE_APPROVED=y
BR2_PACKAGE_QT5BASE_EXAMPLES=y
BR2_PACKAGE_QT5BASE_MYSQL=y
BR2_PACKAGE_QT5BASE_PSQL=y
BR2_PACKAGE_QT5BASE_SQLITE_QT=y
BR2_PACKAGE_QT5BASE_GIF=y
BR2_PACKAGE_QT5BASE_JPEG=y
BR2_PACKAGE_QT5BASE_TSLIB=y
BR2_PACKAGE_QT5CONNECTIVITY=y
BR2_PACKAGE_QT5DECLARATIVE=y
BR2_PACKAGE_QT5ENGINIO=y
BR2_PACKAGE_QT5IMAGEFORMATS=y
BR2_PACKAGE_QT5MULTIMEDIA=y
BR2_PACKAGE_QT5SENSORS=y
BR2_PACKAGE_QT5SERIALPORT=y
BR2_PACKAGE_QT5SVG=y
BR2_PACKAGE_QT5TOOLS=y
BR2_PACKAGE_QT5TOOLS_LINGUIST_TOOLS=y
BR2_PACKAGE_QT5TOOLS_PIXELTOOL=y
BR2_PACKAGE_QT5TOOLS_QTDIAG=y
BR2_PACKAGE_QT5TOOLS_QTPATHS=y
BR2_PACKAGE_QT5TOOLS_QTPLUGININFO=y
BR2_PACKAGE_QT5WEBCHANNEL=y
BR2_PACKAGE_QT5QUICK1=y
BR2_PACKAGE_QT5WEBKIT=y
BR2_PACKAGE_QT5WEBKIT_EXAMPLES=y
BR2_PACKAGE_FREETYPE=y
BR2_TARGET_ROOTFS_CPIO=y
```

## configs/snps_archs38_glibc_defconfig
```kconfig
BR2_arcle=y
BR2_archs38=y
BR2_TOOLCHAIN_BUILDROOT_GLIBC=y
BR2_BINUTILS_VERSION_2_29_X=y
```

## configs/snps_archs38_haps_defconfig
```kconfig
BR2_arcle=y
BR2_archs38=y
BR2_KERNEL_HEADERS_4_13=y
BR2_LINUX_KERNEL=y
BR2_LINUX_KERNEL_CUSTOM_VERSION=y
BR2_LINUX_KERNEL_CUSTOM_VERSION_VALUE="4.14-rc8"
BR2_LINUX_KERNEL_DEFCONFIG="haps_hs_smp"
BR2_LINUX_KERNEL_VMLINUX=y
BR2_PACKAGE_LMBENCH=y
BR2_PACKAGE_LTP_TESTSUITE=y
BR2_PACKAGE_RT_TESTS=y
BR2_TARGET_ROOTFS_INITRAMFS=y
BR2_PACKAGE_HOST_UBOOT_TOOLS=y
```

## configs/snps_archs38_hsdk_armada_defconfig
```kconfig
BR2_arcle=y
BR2_archs38=y
BR2_KERNEL_HEADERS_4_13=y
BR2_TOOLCHAIN_BUILDROOT_LOCALE=y
BR2_TOOLCHAIN_BUILDROOT_CXX=y
BR2_TARGET_GENERIC_HOSTNAME="axs103"
BR2_TARGET_GENERIC_ISSUE="Welcome to the ARC Software Development Platform"
BR2_SYSTEM_DHCP="eth0"
BR2_ROOTFS_OVERLAY="board/synopsys/axs10x/fs-overlay"
BR2_LINUX_KERNEL=y
BR2_LINUX_KERNEL_CUSTOM_GIT=y
BR2_LINUX_KERNEL_CUSTOM_REPO_URL="https://github.com/foss-for-synopsys-dwc-arc-processors/linux.git"
BR2_LINUX_KERNEL_CUSTOM_REPO_VERSION="dc4e1dc"
BR2_LINUX_KERNEL_DEFCONFIG="hsdk"
BR2_PACKAGE_GLMARK2=y
BR2_PACKAGE_KMSCUBE=y
BR2_PACKAGE_MESA3D_DEMOS=y
BR2_PACKAGE_MESA3D=y
BR2_PACKAGE_MESA3D_GALLIUM_DRIVER_ETNAVIV=y
BR2_PACKAGE_MESA3D_OSMESA=y
BR2_PACKAGE_MESA3D_OPENGL_ES=y
BR2_PACKAGE_MESA3D_OPENGL_TEXTURE_FLOAT=y
BR2_PACKAGE_XORG7=y
BR2_PACKAGE_XSERVER_XORG_SERVER=y
BR2_PACKAGE_XSERVER_XORG_SERVER_XVFB=y
BR2_PACKAGE_XCB_UTIL_CURSOR=y
BR2_PACKAGE_XCB_UTIL_KEYSYMS=y
BR2_PACKAGE_XCB_UTIL_WM=y
BR2_PACKAGE_XLIB_LIBFS=y
BR2_PACKAGE_XLIB_LIBXSCRNSAVER=y
BR2_PACKAGE_XLIB_LIBXCOMPOSITE=y
BR2_PACKAGE_XLIB_LIBXFONT=y
BR2_PACKAGE_XLIB_LIBXTST=y
BR2_PACKAGE_XLIB_LIBXVMC=y
BR2_PACKAGE_XLIB_LIBXXF86DGA=y
BR2_PACKAGE_XLIB_LIBDMX=y
BR2_PACKAGE_XAPP_BITMAP=y
BR2_PACKAGE_XAPP_ICO=y
BR2_PACKAGE_XAPP_OCLOCK=y
BR2_PACKAGE_XAPP_RGB=y
BR2_PACKAGE_XAPP_XCALC=y
BR2_PACKAGE_XAPP_XCLOCK=y
BR2_PACKAGE_XAPP_XEYES=y
BR2_PACKAGE_XDRIVER_XF86_INPUT_JOYSTICK=y
BR2_PACKAGE_XDRIVER_XF86_INPUT_KEYBOARD=y
BR2_PACKAGE_XDRIVER_XF86_INPUT_MOUSE=y
BR2_PACKAGE_XDRIVER_XF86_VIDEO_ARMADA=y
BR2_PACKAGE_XDRIVER_XF86_VIDEO_FBDEV=y
BR2_PACKAGE_XDRIVER_XF86_VIDEO_VESA=y
BR2_PACKAGE_XFONT_FONT_XFREE86_TYPE1=y
BR2_PACKAGE_XPROTO_DRI3PROTO=y
BR2_PACKAGE_XPROTO_FONTCACHEPROTO=y
BR2_PACKAGE_XPROTO_WINDOWSWMPROTO=y
BR2_PACKAGE_XPROTO_XPROXYMANAGEMENTPROTOCOL=y
BR2_PACKAGE_CAIRO=y
BR2_PACKAGE_CAIRO_PNG=y
BR2_PACKAGE_LIBDRI2=y
BR2_PACKAGE_LIBDRM_ARMADA=y
BR2_TARGET_ROOTFS_INITRAMFS=y
BR2_TARGET_UBOOT=y
BR2_TARGET_UBOOT_BUILD_SYSTEM_KCONFIG=y
BR2_TARGET_UBOOT_CUSTOM_VERSION=y
BR2_TARGET_UBOOT_CUSTOM_VERSION_VALUE="2017.01"
BR2_TARGET_UBOOT_PATCH="board/synopsys/axs10x/patches/u-boot"
BR2_TARGET_UBOOT_BOARD_DEFCONFIG="axs103"
BR2_TARGET_UBOOT_NEEDS_DTC=y
```

## configs/snps_archs38_hsdk_defconfig
```kconfig
BR2_arcle=y
BR2_archs38=y
BR2_JLEVEL=1
BR2_ENABLE_DEBUG=y
BR2_DEBUG_3=y
# BR2_STRIP_strip is not set
BR2_TOOLCHAIN_BUILDROOT_GLIBC=y
BR2_TARGET_GENERIC_HOSTNAME="glibc@upstream"
BR2_TARGET_GENERIC_ISSUE="Welcome to the ARC Software Development Platform"
BR2_SYSTEM_DHCP="eth0"
BR2_SYSTEM_ENABLE_NLS=y
BR2_ROOTFS_OVERLAY="board/synopsys/axs10x/fs-overlay"
BR2_PACKAGE_STRACE=y
BR2_PACKAGE_OPENSSH=y
BR2_TARGET_ROOTFS_CPIO=y
BR2_PACKAGE_HOST_DTC=y
BR2_PACKAGE_HOST_UBOOT_TOOLS=y
```

## configs/snps_archs38_hsdk_minimal_defconfig
```kconfig
BR2_arcle=y
BR2_archs38=y
BR2_TOOLCHAIN_BUILDROOT_GLIBC=y
BR2_KERNEL_HEADERS_4_18=y
BR2_LINUX_KERNEL=y
BR2_LINUX_KERNEL_CUSTOM_VERSION=y
BR2_LINUX_KERNEL_CUSTOM_VERSION_VALUE="4.18.9"
BR2_LINUX_KERNEL_DEFCONFIG="hsdk"
BR2_LINUX_KERNEL_VMLINUX=y
BR2_TARGET_ROOTFS_INITRAMFS=y
```

## configs/snps_hs38_mesa3d_defconfig
```kconfig
BR2_arcle=y
BR2_archs38=y
BR2_COMPILER_PARANOID_UNSAFE_PATH=y
BR2_TOOLCHAIN_BUILDROOT_INET_RPC=y
BR2_TOOLCHAIN_BUILDROOT_LOCALE=y
BR2_TOOLCHAIN_BUILDROOT_CXX=y
BR2_PACKAGE_MESA3D=y
BR2_PACKAGE_MESA3D_GALLIUM_DRIVER_SWRAST=y
```

## configs/snps_nsim_hs_defconfig
```kconfig
BR2_arcle=y
BR2_archs38=y
BR2_CCACHE=y
BR2_KERNEL_HEADERS_4_5=y
BR2_LINUX_KERNEL=y
BR2_LINUX_KERNEL_CUSTOM_GIT=y
BR2_LINUX_KERNEL_CUSTOM_REPO_URL="https://git.kernel.org/pub/scm/linux/kernel/git/torvalds/linux.git"
BR2_LINUX_KERNEL_CUSTOM_REPO_VERSION="d34687ab97731b3a707106f78756342b61f46dbc"
BR2_LINUX_KERNEL_DEFCONFIG="nsim_hs"
BR2_LINUX_KERNEL_VMLINUX=y
BR2_TARGET_ROOTFS_INITRAMFS=y
```

## configs/wandboard_defconfig
```kconfig
BR2_arm=y
BR2_cortex_a9=y
BR2_ARM_ENABLE_NEON=y
BR2_ARM_ENABLE_VFP=y
BR2_ARM_FPU_VFPV3=y
BR2_TOOLCHAIN_BUILDROOT_WCHAR=y
BR2_TOOLCHAIN_BUILDROOT_CXX=y
BR2_TARGET_GENERIC_GETTY_PORT="ttymxc0"
BR2_ROOTFS_POST_BUILD_SCRIPT="board/wandboard/post-build.sh"
BR2_ROOTFS_POST_IMAGE_SCRIPT="board/wandboard/post-image.sh"
BR2_LINUX_KERNEL=y
BR2_LINUX_KERNEL_CUSTOM_VERSION=y
BR2_LINUX_KERNEL_CUSTOM_VERSION_VALUE="4.13.3"
BR2_LINUX_KERNEL_DEFCONFIG="imx_v6_v7"
BR2_LINUX_KERNEL_DTS_SUPPORT=y
BR2_LINUX_KERNEL_INTREE_DTS_NAME="imx6q-wandboard imx6dl-wandboard imx6q-wandboard-revb1 imx6dl-wandboard-revb1"
BR2_LINUX_KERNEL_INSTALL_TARGET=y
BR2_PACKAGE_GLMARK2=y
BR2_PACKAGE_MESA3D=y
BR2_PACKAGE_MESA3D_GALLIUM_DRIVER_ETNAVIV=y
BR2_PACKAGE_MESA3D_OSMESA=y
BR2_PACKAGE_MESA3D_OPENGL_ES=y
BR2_PACKAGE_XORG7=y
BR2_PACKAGE_XSERVER_XORG_SERVER=y
BR2_PACKAGE_XSERVER_XORG_SERVER_XVFB=y
BR2_PACKAGE_XCB_UTIL_IMAGE=y
BR2_PACKAGE_XCB_UTIL_KEYSYMS=y
BR2_PACKAGE_XCB_UTIL_RENDERUTIL=y
BR2_PACKAGE_XCB_UTIL_WM=y
BR2_PACKAGE_XLIB_LIBFS=y
BR2_PACKAGE_XLIB_LIBXCOMPOSITE=y
BR2_PACKAGE_XAPP_ICO=y
BR2_PACKAGE_XAPP_RGB=y
BR2_PACKAGE_XAPP_XCALC=y
BR2_PACKAGE_XAPP_XCLOCK=y
BR2_PACKAGE_XAPP_XEYES=y
BR2_PACKAGE_XDRIVER_XF86_INPUT_KEYBOARD=y
BR2_PACKAGE_XDRIVER_XF86_INPUT_MOUSE=y
BR2_PACKAGE_XDRIVER_XF86_VIDEO_ARMADA=y
BR2_PACKAGE_XDRIVER_XF86_VIDEO_FBDEV=y
BR2_PACKAGE_XDRIVER_XF86_VIDEO_VESA=y
BR2_PACKAGE_XFONT_FONT_XFREE86_TYPE1=y
BR2_PACKAGE_XPROTO_DRI3PROTO=y
BR2_PACKAGE_XTERM=y
BR2_PACKAGE_LIBDRI2=y
BR2_PACKAGE_LIBDRM_ARMADA=y
BR2_TARGET_ROOTFS_EXT2=y
BR2_TARGET_ROOTFS_EXT2_4=y
BR2_TARGET_UBOOT=y
BR2_TARGET_UBOOT_BOARDNAME="wandboard"
BR2_TARGET_UBOOT_CUSTOM_VERSION=y
BR2_TARGET_UBOOT_CUSTOM_VERSION_VALUE="2017.09"
BR2_TARGET_UBOOT_FORMAT_IMG=y
BR2_TARGET_UBOOT_SPL=y
BR2_TARGET_UBOOT_SPL_NAME="SPL"
BR2_PACKAGE_HOST_DOSFSTOOLS=y
BR2_PACKAGE_HOST_GENIMAGE=y
BR2_PACKAGE_HOST_MTOOLS=y
BR2_PACKAGE_HOST_UBOOT_TOOLS=y
```

## package/libdrm-armada/Config.in
```kconfig
config BR2_PACKAGE_LIBDRM_ARMADA
	bool "libdrm-armada"
	select BR2_PACKAGE_LIBDRM
	help
	  Direct Rendering Manager

	  http://dri.freedesktop.org/libdrm/
```

## package/perl-font-ttf/Config.in
```kconfig
config BR2_PACKAGE_PERL_FONT_TTF
	bool "perl-font-ttf"
	help
	  Font::TTF - Perl module for TrueType Font hacking

	  https://github.com/silnrsi/font-ttf
```

## package/x11r7/xdriver_xf86-video-armada/Config.in
```kconfig
config BR2_PACKAGE_XDRIVER_XF86_VIDEO_ARMADA
	bool "xf86-video-armada"
	help
	  Intel video driver
```
